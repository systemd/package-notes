SECTIONS
{
    .note.package (READONLY) : ALIGN(4) {
        LONG(0x0004)                                /* Length of Owner including NUL */
        LONG(0x0133)                                /* Length of Value including NUL */
        LONG(0xcafe1a7e)                            /* Note ID */
        BYTE(0x46) BYTE(0x44) BYTE(0x4f) BYTE(0x00) /* Owner: 'FDO\x00' */
        BYTE(0x7b) BYTE(0x22) BYTE(0x74) BYTE(0x79) /* Value: '{"type":"rpm","name":"rust-plist+enable_unstable_features_that_may_break_with_minor_version_bumps-devel","version":"200:1.3.1~rc1.post2^final3","architecture":"ppc64le","osCpe":"cpe:/o:fedoraproject:fedora:35","debugInfoUrl":"https://somewhere.on.the.internet.there.is.a.server.which.is.never.wrong/query"}\x00\x00' */
        BYTE(0x70) BYTE(0x65) BYTE(0x22) BYTE(0x3a)
        BYTE(0x22) BYTE(0x72) BYTE(0x70) BYTE(0x6d)
        BYTE(0x22) BYTE(0x2c) BYTE(0x22) BYTE(0x6e)
        BYTE(0x61) BYTE(0x6d) BYTE(0x65) BYTE(0x22)
        BYTE(0x3a) BYTE(0x22) BYTE(0x72) BYTE(0x75)
        BYTE(0x73) BYTE(0x74) BYTE(0x2d) BYTE(0x70)
        BYTE(0x6c) BYTE(0x69) BYTE(0x73) BYTE(0x74)
        BYTE(0x2b) BYTE(0x65) BYTE(0x6e) BYTE(0x61)
        BYTE(0x62) BYTE(0x6c) BYTE(0x65) BYTE(0x5f)
        BYTE(0x75) BYTE(0x6e) BYTE(0x73) BYTE(0x74)
        BYTE(0x61) BYTE(0x62) BYTE(0x6c) BYTE(0x65)
        BYTE(0x5f) BYTE(0x66) BYTE(0x65) BYTE(0x61)
        BYTE(0x74) BYTE(0x75) BYTE(0x72) BYTE(0x65)
        BYTE(0x73) BYTE(0x5f) BYTE(0x74) BYTE(0x68)
        BYTE(0x61) BYTE(0x74) BYTE(0x5f) BYTE(0x6d)
        BYTE(0x61) BYTE(0x79) BYTE(0x5f) BYTE(0x62)
        BYTE(0x72) BYTE(0x65) BYTE(0x61) BYTE(0x6b)
        BYTE(0x5f) BYTE(0x77) BYTE(0x69) BYTE(0x74)
        BYTE(0x68) BYTE(0x5f) BYTE(0x6d) BYTE(0x69)
        BYTE(0x6e) BYTE(0x6f) BYTE(0x72) BYTE(0x5f)
        BYTE(0x76) BYTE(0x65) BYTE(0x72) BYTE(0x73)
        BYTE(0x69) BYTE(0x6f) BYTE(0x6e) BYTE(0x5f)
        BYTE(0x62) BYTE(0x75) BYTE(0x6d) BYTE(0x70)
        BYTE(0x73) BYTE(0x2d) BYTE(0x64) BYTE(0x65)
        BYTE(0x76) BYTE(0x65) BYTE(0x6c) BYTE(0x22)
        BYTE(0x2c) BYTE(0x22) BYTE(0x76) BYTE(0x65)
        BYTE(0x72) BYTE(0x73) BYTE(0x69) BYTE(0x6f)
        BYTE(0x6e) BYTE(0x22) BYTE(0x3a) BYTE(0x22)
        BYTE(0x32) BYTE(0x30) BYTE(0x30) BYTE(0x3a)
        BYTE(0x31) BYTE(0x2e) BYTE(0x33) BYTE(0x2e)
        BYTE(0x31) BYTE(0x7e) BYTE(0x72) BYTE(0x63)
        BYTE(0x31) BYTE(0x2e) BYTE(0x70) BYTE(0x6f)
        BYTE(0x73) BYTE(0x74) BYTE(0x32) BYTE(0x5e)
        BYTE(0x66) BYTE(0x69) BYTE(0x6e) BYTE(0x61)
        BYTE(0x6c) BYTE(0x33) BYTE(0x22) BYTE(0x2c)
        BYTE(0x22) BYTE(0x61) BYTE(0x72) BYTE(0x63)
        BYTE(0x68) BYTE(0x69) BYTE(0x74) BYTE(0x65)
        BYTE(0x63) BYTE(0x74) BYTE(0x75) BYTE(0x72)
        BYTE(0x65) BYTE(0x22) BYTE(0x3a) BYTE(0x22)
        BYTE(0x70) BYTE(0x70) BYTE(0x63) BYTE(0x36)
        BYTE(0x34) BYTE(0x6c) BYTE(0x65) BYTE(0x22)
        BYTE(0x2c) BYTE(0x22) BYTE(0x6f) BYTE(0x73)
        BYTE(0x43) BYTE(0x70) BYTE(0x65) BYTE(0x22)
        BYTE(0x3a) BYTE(0x22) BYTE(0x63) BYTE(0x70)
        BYTE(0x65) BYTE(0x3a) BYTE(0x2f) BYTE(0x6f)
        BYTE(0x3a) BYTE(0x66) BYTE(0x65) BYTE(0x64)
        BYTE(0x6f) BYTE(0x72) BYTE(0x61) BYTE(0x70)
        BYTE(0x72) BYTE(0x6f) BYTE(0x6a) BYTE(0x65)
        BYTE(0x63) BYTE(0x74) BYTE(0x3a) BYTE(0x66)
        BYTE(0x65) BYTE(0x64) BYTE(0x6f) BYTE(0x72)
        BYTE(0x61) BYTE(0x3a) BYTE(0x33) BYTE(0x35)
        BYTE(0x22) BYTE(0x2c) BYTE(0x22) BYTE(0x64)
        BYTE(0x65) BYTE(0x62) BYTE(0x75) BYTE(0x67)
        BYTE(0x49) BYTE(0x6e) BYTE(0x66) BYTE(0x6f)
        BYTE(0x55) BYTE(0x72) BYTE(0x6c) BYTE(0x22)
        BYTE(0x3a) BYTE(0x22) BYTE(0x68) BYTE(0x74)
        BYTE(0x74) BYTE(0x70) BYTE(0x73) BYTE(0x3a)
        BYTE(0x2f) BYTE(0x2f) BYTE(0x73) BYTE(0x6f)
        BYTE(0x6d) BYTE(0x65) BYTE(0x77) BYTE(0x68)
        BYTE(0x65) BYTE(0x72) BYTE(0x65) BYTE(0x2e)
        BYTE(0x6f) BYTE(0x6e) BYTE(0x2e) BYTE(0x74)
        BYTE(0x68) BYTE(0x65) BYTE(0x2e) BYTE(0x69)
        BYTE(0x6e) BYTE(0x74) BYTE(0x65) BYTE(0x72)
        BYTE(0x6e) BYTE(0x65) BYTE(0x74) BYTE(0x2e)
        BYTE(0x74) BYTE(0x68) BYTE(0x65) BYTE(0x72)
        BYTE(0x65) BYTE(0x2e) BYTE(0x69) BYTE(0x73)
        BYTE(0x2e) BYTE(0x61) BYTE(0x2e) BYTE(0x73)
        BYTE(0x65) BYTE(0x72) BYTE(0x76) BYTE(0x65)
        BYTE(0x72) BYTE(0x2e) BYTE(0x77) BYTE(0x68)
        BYTE(0x69) BYTE(0x63) BYTE(0x68) BYTE(0x2e)
        BYTE(0x69) BYTE(0x73) BYTE(0x2e) BYTE(0x6e)
        BYTE(0x65) BYTE(0x76) BYTE(0x65) BYTE(0x72)
        BYTE(0x2e) BYTE(0x77) BYTE(0x72) BYTE(0x6f)
        BYTE(0x6e) BYTE(0x67) BYTE(0x2f) BYTE(0x71)
        BYTE(0x75) BYTE(0x65) BYTE(0x72) BYTE(0x79)
        BYTE(0x22) BYTE(0x7d) BYTE(0x00) BYTE(0x00)
    }
}
INSERT AFTER .note.gnu.build-id;
/* HINT: add -Wl,-dT,/path/to/this/file to $LDFLAGS */
